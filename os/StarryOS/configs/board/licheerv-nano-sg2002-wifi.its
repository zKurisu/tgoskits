## os/StarryOS/configs/board/licheerv-nano-sg2002-wifi.its
```
/dts-v1/;

/ {
    description = "StarryOS SG2002";
    #address-cells = <1>;

    images {
        kernel-1 {
            data = /incbin/("${kernel_bin}");
            type = "kernel";
            arch = "riscv";
            os = "linux";
            compression = "none";
            load = <0x80200000>;
            entry = <0x80200000>;

            hash-1 {
                algo = "sha256";
            };
        };

        fdt-1 {
            data = /incbin/("${its_dir}/licheerv-nano-sg2002.dtb");
            type = "flat_dt";
            arch = "riscv";
            compression = "none";

            hash-1 {
                algo = "sha256";
            };
        };
    };

    configurations {
        default = "config-sg2002_licheervnano_sd";

        config-sg2002_licheervnano_sd {
            kernel = "kernel-1";
            fdt = "fdt-1";
        };
    };
};
```
